## arch/arm/mach-rockchip/rv1106/Kconfig
```kconfig
if ROCKCHIP_RV1106

config TARGET_EVB_RV1106
	bool "EVB_RV1106"
	help
	  RV1106 EVB is a evaluation board for Rockchp RV1106.

config TARGET_AAW2
	bool "AAW2"
	help
	  AAWireless 2.

config TARGET_AAW2B
	bool "AAW2B"
	help
	  AAWireless 2B.

config SYS_SOC
	default "rockchip"

config SYS_MALLOC_F_LEN
	default 0x400

source board/rockchip/evb_rv1106/Kconfig
source board/rockchip/aaw2/Kconfig
source board/rockchip/aaw2b/Kconfig

endif
```

## board/rockchip/aaw2b/Kconfig
```kconfig
if TARGET_AAW2B

config SYS_BOARD
	default "aaw2b"

config SYS_VENDOR
	default "rockchip"

config SYS_CONFIG_NAME
	default "aaw2b"

config BOARD_SPECIFIC_OPTIONS # dummy
	def_bool y

endif
```
