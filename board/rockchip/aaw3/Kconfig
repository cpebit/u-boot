## board/rockchip/aaw3/Kconfig
```kconfig
if TARGET_AAW3

config SYS_BOARD
	default "aaw3"

config SYS_VENDOR
	default "rockchip"

config SYS_CONFIG_NAME
	default "aaw3"

config BOARD_SPECIFIC_OPTIONS # dummy
	def_bool y

endif
```
